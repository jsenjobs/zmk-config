## config/west.yml
```yaml
manifest:
  remotes:
    - name: zmkfirmware
      url-base: https://github.com/zmkfirmware
    - name: jsenjobs
      url-base: https://github.com/jsenjobs
  projects:
    - name: zmk
      remote: jsenjobs
      revision: main
      import: app/west.yml
  self:
    path: config
```
